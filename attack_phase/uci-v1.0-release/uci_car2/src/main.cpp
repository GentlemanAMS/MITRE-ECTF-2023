#include <Arduino.h>
#include "driverlib/uart.h"


int32_t uart_read(uint32_t uart_port, uint8_t* buffer, uint32_t buffer_length, uint32_t timeout)
{
    uint32_t bytes_read = 0;
    uint32_t start_read_time = millis();

    while((millis() < start_read_time + timeout) && bytes_read < buffer_length){
        if (!UARTCharsAvail(uart_port)) continue;
        buffer[bytes_read] = (uint8_t)UARTCharGet(uart_port);
        bytes_read++;
    }
    if (bytes_read == buffer_length) return 0;
    else return -1;
}


void uart_write(uint32_t uart_port, uint8_t* buffer, uint32_t buffer_length)
{
    uint32_t i;
    for (i = 0; i < buffer_length; i++)
        UARTCharPut(uart_port, buffer[i]);
}

/*
int i = 0;

void setup() {
  // put your setup code here, to run once:
  Serial.begin(115200);
  Serial1.begin(115200);
  
  Serial.println("uint8_t fob_to_car[][18] = {");
  i = 0;
}

uint8_t send_nonce[3] = {87, 1, 0};
uint8_t receive_hash[18];

void loop() {
  // put your main code here, to run repeatedly:

  if (i < 256)
  {
    send_nonce[0] = 87;
    send_nonce[1] = 1;
    send_nonce[2] = i;
    uart_write(UART1_BASE, send_nonce, 3);

    int result = uart_read(UART1_BASE, receive_hash, 2, 100);
    if (result == -1) return;
    int bytes_to_read = receive_hash[1];
    Serial.print("  {");
    uart_read(UART1_BASE, receive_hash+2, bytes_to_read, 10000000);
    for (int ii = 0; ii < 17; ii++)
    {
      Serial.print(receive_hash[ii]);
      Serial.print(", ");
    }
    Serial.print(receive_hash[17]);
    Serial.println("},");
    i++;
  }
  else{
    delay(1000);
  }
  if (i==256)
    Serial.println("};");
}
*/


uint8_t fob_to_car[][18] = {
  {86, 16, 202, 114, 193, 18, 186, 146, 46, 175, 251, 72, 202, 175, 203, 21, 136, 175},
  {86, 16, 139, 219, 205, 164, 29, 154, 152, 3, 135, 124, 105, 125, 226, 237, 26, 194},
  {86, 16, 195, 243, 33, 202, 182, 155, 234, 11, 147, 141, 150, 160, 60, 103, 108, 57},
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  {86, 16, 231, 58, 157, 70, 93, 28, 117, 67, 69, 93, 161, 83, 101, 170, 225, 187},
};


int i = 0;

void setup() {
  // put your setup code here, to run once:
  Serial.begin(115200);
  Serial1.begin(115200);
}

uint8_t receive_buffer[3];

void loop() 
{
  int result = uart_read(UART1_BASE, receive_buffer, 3, 10000);
  if (result == 0)
  {
    if(receive_buffer[0] == 87)
    {
      uint8_t row_index = receive_buffer[2];
      Serial.print("row ");
      Serial.println(row_index);

      Serial.print(fob_to_car[row_index][0]);
      Serial.print(" ");
      Serial.print(fob_to_car[row_index][1]);
      Serial.print(" ");
      for (int ii = 0; ii < fob_to_car[row_index][1]; ii++)
      {
        Serial.print(fob_to_car[row_index][ii+2]);
        Serial.print(" ");
      }
      Serial.println(" ");

      uint8_t bytes_to_send = fob_to_car[row_index][1] + 2;
      uart_write(UART1_BASE, fob_to_car[row_index], bytes_to_send);
    }
    else{
      Serial.println("Mistake");
    }
  }
  else{
    Serial.println("Didn't receive");
  }
}
