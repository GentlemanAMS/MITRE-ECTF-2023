#include <Arduino.h>
#include "driverlib/uart.h"
#define PAYLOAD_BUF_SIZE 408

typedef struct {
    uint8_t target;
    uint8_t msg_magic;
    uint64_t c_nonce;
    uint64_t s_nonce;
    size_t payload_size;
    uint8_t payload_buf[PAYLOAD_BUF_SIZE];
    uint8_t payload_hash[32];
} Message;


int32_t uart_read(uint32_t uart_port, uint8_t* buffer, uint32_t buffer_length, uint32_t timeout)
{
    uint32_t bytes_read = 0;
    uint32_t start_read_time = millis();

    while((millis() < start_read_time + timeout) && bytes_read < buffer_length){
        if (!UARTCharsAvail(uart_port)) continue;
        buffer[bytes_read] = (uint8_t)UARTCharGet(uart_port);
        bytes_read++;
    }
    if (bytes_read == buffer_length) return 0;
    else return -1;
}


void uart_write(uint32_t uart_port, uint8_t* buffer, uint32_t buffer_length)
{
    uint32_t i;
    for (i = 0; i < buffer_length; i++)
        UARTCharPut(uart_port, buffer[i]);
}


int uart_read_message(uint8_t* message)
{
  uint8_t temp_buffer[4];
  int result = uart_read(UART1_BASE, temp_buffer, 4, 10000);
  if (result == -1) return result;
  int i = 0;
  uint8_t ack = 65;
  while(i < sizeof(Message)) {
    int result = uart_read(UART1_BASE, message+i, 1, 1000);
    if (result == -1) return result;    
    if (i % 8 == 0) 
      uart_write(UART1_BASE, &ack, 1);
    i = i+1;
  }
  return 0;
}

uint8_t uart_magic[] = "0ops";
int uart_write_message(uint8_t* message)
{
  uint8_t ack;
  int result;
  uart_write(UART1_BASE, uart_magic, 4);
  for(size_t i = 0; i < sizeof(Message); i++) {
      uart_write(UART1_BASE, message+i, 1);
      if(i % 8 == 0) {
          result = uart_read(UART1_BASE, &ack, 1, 1000);
          if (result == -1) return -1;
      }
  } 
  return 0; 
}




int result;

uint8_t fob_to_car_start[5][472] = {
  {99, 72, 0, 0, 0, 0, 0, 0, 82, 76, 41, 86, 170,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 0, 0},
  {115, 99, 72, 0, 0, 0, 0, 0, 0, 21, 105, 83, 226,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 0, 0},
  {99, 72, 0, 0, 0, 0, 0, 0, 23, 186, 133, 142, 231,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 0, 0},
  {99, 72, 0, 0, 0, 0, 0, 0, 57, 128, 168, 160, 12,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 0, 0},
  {99, 72, 0, 0, 0, 0, 0, 0, 204, 227, 175, 160, 171,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 0, 0}
};

uint8_t car_to_fob_challenge[5][472] = {
  {112, 67, 0, 0, 0, 0, 0, 0, 82, 76, 41, 86, 170,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 0, 0},
  {112, 67, 0, 0, 0, 0, 0, 0, 82, 76, 41, 86, 170,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 0, 0},
  {112, 67, 0, 0, 0, 0, 0, 0, 82, 76, 41, 86, 170,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 0, 0},
  {112, 67, 0, 0, 0, 0, 0, 0, 82, 76, 41, 86, 170,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 0, 0},
  {112, 67, 0, 0, 0, 0, 0, 0, 82, 76, 41, 86, 170,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 0, 0}
};

uint8_t fob_to_car_response[5][472] = {
  {99, 83, 0, 0, 0, 0, 0, 0, 82, 76, 41, 86, 170,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 0, 0},
  {115, 99, 72, 0, 0, 0, 0, 0, 0, 21, 105, 83, 226,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 0, 0},
  {115, 99, 72, 0, 0, 0, 0, 0, 0, 60, 148, 126, 170,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 0, 0},
  {99, 72, 0, 0, 0, 0, 0, 0, 95, 4, 35, 209, 106,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 0, 0},
  {99, 72, 0, 0, 0, 0, 0, 0, 146, 65, 128, 213, 170,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 0, 0}
};

uint8_t car_nonce[472];

void setup() {
  // put your setup code here, to run once:
  Serial.begin(115200);
  Serial1.begin(115200);

  int result;
  result = uart_write_message(fob_to_car_start[0]);
  if (result == -1) return;
  result = uart_read_message(car_nonce);
  if (result == -1) return;

  int i;
  int matches;
  for (i = 0; i < 5; i++)
  {
    matches = true;
    for(int j = 0; j < 89; j++)
    {
      if(car_to_fob_challenge[i][j] != car_nonce[j])
      {
        matches = false;
        break;
      }
    }
    if (matches == true)
      break;
  }
  uart_write_message(fob_to_car_response[i]);
}


void loop() {

/*
  Serial.println("First one start");
  result = uart_read_message(fob_to_car_start[0]);
  if (result != 0)
  {
    Serial.println("Receive Start failed");
    return;
  }
  result = uart_write_message(car_to_fob_challenge[0]);
  if (result != 0)
  {
    Serial.println("Send Challenge Failed");
    return;
  }
  result = uart_read_message(fob_to_car_response[0]);
  if (result != 0)
  {
    Serial.println("Receive Response failed");
    return;
  }
  for (int ii = 0; ii < 472; ii++) {
    Serial.print(fob_to_car_response[0][ii]);
    Serial.print(", ");
  }
  Serial.println(" ");
  Serial.println("First one done");
  delay(3000);




  Serial.println("Second one start");
  result = uart_read_message(fob_to_car_start[1]);
  if (result != 0)
  {
    Serial.println("Receive Start failed");
    return;
  }
  result = uart_write_message(car_to_fob_challenge[1]);
  if (result != 0)
  {
    Serial.println("Send Challenge Failed");
    return;
  }
  result = uart_read_message(fob_to_car_response[1]);
  if (result != 0)
  {
    Serial.println("Receive Response failed");
    return;
  }
  for (int ii = 0; ii < 472; ii++) {
    Serial.print(fob_to_car_response[1][ii]);
    Serial.print(", ");
  }
  Serial.println(" ");
  Serial.println("Second one done");
  delay(3000);




  Serial.println("Third one start");
  result = uart_read_message(fob_to_car_start[2]);
  if (result != 0)
  {
    Serial.println("Receive Start failed");
    return;
  }
  result = uart_write_message(car_to_fob_challenge[2]);
  if (result != 0)
  {
    Serial.println("Send Challenge Failed");
    return;
  }
  result = uart_read_message(fob_to_car_response[2]);
  if (result != 0)
  {
    Serial.println("Receive Response failed");
    return;
  }
  for (int ii = 0; ii < 472; ii++) {
    Serial.print(fob_to_car_response[2][ii]);
    Serial.print(", ");
  }
  Serial.println(" ");
  Serial.println("Third one done");
  delay(3000);



  Serial.println("Fourth one start");
  result = uart_read_message(fob_to_car_start[3]);
  if (result != 0)
  {
    Serial.println("Receive Start failed");
    return;
  }
  result = uart_write_message(car_to_fob_challenge[3]);
  if (result != 0)
  {
    Serial.println("Send Challenge Failed");
    return;
  }
  result = uart_read_message(fob_to_car_response[3]);
  if (result != 0)
  {
    Serial.println("Receive Response failed");
    return;
  }
  for (int ii = 0; ii < 472; ii++) {
    Serial.print(fob_to_car_response[3][ii]);
    Serial.print(", ");
  }
  Serial.println(" ");
  Serial.println("Fourht one done");
  delay(3000);





  Serial.println("Fifth one start");
  result = uart_read_message(fob_to_car_start[4]);
  if (result != 0)
  {
    Serial.println("Receive Start failed");
    return;
  }
  result = uart_write_message(car_to_fob_challenge[4]);
  if (result != 0)
  {
    Serial.println("Send Challenge Failed");
    return;
  }
  result = uart_read_message(fob_to_car_response[4]);
  if (result != 0)
  {
    Serial.println("Receive Response failed");
    return;
  }
  for (int ii = 0; ii < 472; ii++) {
    Serial.print(fob_to_car_response[4][ii]);
    Serial.print(", ");
  }
  Serial.println(" ");
  Serial.println("Fifth one done");
  delay(3000);

  delay(1000);

*/
}